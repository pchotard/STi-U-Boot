## drivers/usb/phy/Kconfig
```kconfig
menu "USB PHY drivers"

config USB_PHY
	bool "Enable driver model for USB PHY drivers"
	depends on DM
	help
	  Enable driver model for USB PHY access. It defines basic
	  init and exit API.

endmenu
```
